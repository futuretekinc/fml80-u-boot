## board/futuretek/fml80/Kconfig
```kconfig
if TARGET_AM335X_FML80

config SYS_BOARD
	default "fml80"

config SYS_VENDOR
	default "futuretek"

config SYS_SOC
	default "am33xx"

config SYS_CONFIG_NAME
	default "am335x_fml80"

choice
	prompt "enable different boot versions for the FML80 board"
	default SDBOOT
	help
	  Select the boot version of the FML80 board.

config FML80_EMMC
	bool "enable eMMC"
	help
	  enable here the eMMC functionality on the bosch FML80 board.

config FML80_ICT
	bool "enable ICT"
	help
	  enable here the ICT functionality on the bosch FML80 board

config FML80_NETBOOT
	bool "enable NETBOOT"
	help
	  enable here the NETBOOT functionality on the bosch FML80 board

config FML80_SDBOOT
	bool "enable SDBOOT"
	help
	  enable here the SDBOOT functionality on the bosch FML80 board

endchoice

choice
	prompt "enable different board versions for the FML80 board"
	default A0
	help
	  Select the board version of the FML80 board.

config FML80_A0
	bool "A0 Sample board version"
	help
	  activate, if you want to build for the A0 sample version
	  of the bosch FML80 board

config FML80_SERIES
	bool "Series board version"
	help
	  activate, if you want to build for the Series version
	  of the bosch FML80 board

endchoice

endif
```
